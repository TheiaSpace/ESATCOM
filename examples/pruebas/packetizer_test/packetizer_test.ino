#include <ESAT_COM.h>
#include <ESAT_COM-hardware/ESAT_COMPacketizer.h>

#define FRAMESIZE 256

ESATPacketizer TXPacketizer = ESATPacketizer(129);

unsigned char writebuff[FRAMESIZE];//= {0xC5, 0xC5, 0xC5, 0xC5, 0xC5, 0xC5, 0xC5, 0xC5, 0xC5, 0xC5, 0xC5, 0xC5, 0xC5,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 0xC5, 0xC5};

uint8_t readbuff[FRAMESIZE];

void initTX(void)
{
  for (uint16_t i =0; i<FRAMESIZE; i++)
  {
    writebuff[i]=i;
  }
}

void initRX(void)
{
  for (uint16_t i =0; i<FRAMESIZE; i++)
  {
    readbuff[i]=0;
  }
}

extern "C" 
{
  void debug (const char* text)
  {
    for (uint16_t t=0; t<129; t++)
    {
     Serial.print(*text, DEC);
     Serial.print(", ");
     text++;
    }
    Serial.println();
  }
}

void setup() 
{

// writebuff[0]='H';
// writebuff[1]='O';
// writebuff[2]='L';
// writebuff[3]='A';
// writebuff[4]=' ';
// writebuff[5]='M';
// writebuff[6]='U';
// writebuff[7]='N';
// writebuff[8]='D';
// writebuff[9]='O';
// writebuff[10]=0;
  
  Serial.begin();
  delay(1000);
  initTX();
  initRX();

  TXPacketizer.loadPacket(writebuff, FRAMESIZE);
}

void loop() 
{ 
  
  //Serial.println(TXPacketizer.getRemainingPacketSize(), DEC);
  if (TXPacketizer.getRemainingPacketSize()) //packet isn't trsnsmitted yet
  {
      Serial.println("Consume packet ");
      TXPacketizer.feedTrimmedPacket();
  }
  else
  {
     //Serial.println(TXPacketizer.getRemainingPacketSize(), DEC);
     TXPacketizer.loadPacket(writebuff, 256); //reload packet
     
  }

  
  delay(1);    
}
