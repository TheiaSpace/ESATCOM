#include <ESAT_COM.h>
#include <ESAT_COM-hardware/ESAT_COMTransceiverDriver.h>
#include <ESAT_COM-hardware/ESAT_COMPacketizer.h>

#define FRAMESIZE 256

ESAT_RadioTransceiverClass TXTransceiver=ESAT_RadioTransceiverClass(TRANSCEIVERTX);
ESAT_RadioTransceiverClass RXTransceiver=ESAT_RadioTransceiverClass(TRANSCEIVERRX);
ESATPacketizer TXPacketizer=ESATPacketizer(129);
ESATPacketizer RXPacketizer=ESATPacketizer(129);

unsigned char writebuff[FRAMESIZE];//= {0x3A, 0x3A, 0x3A, 0x3A, 0x3A, 0x3A, 0x3A, 0x3A, 0x3A, 0x3A, 0x3A, 0x3A, 0x3A,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 0x3A, 0x3A};

uint8_t readbuff[FRAMESIZE];

void initTX(void)
{
  for (uint16_t i =0; i<FRAMESIZE; i++)
  {
    writebuff[i]=i;
  }
}

void initRX(void)
{
  for (uint16_t i =0; i<FRAMESIZE; i++)
  {
    readbuff[i]=0;
  }
}

extern "C" 
{
  void debug (const char* text)
  {
    for (uint16_t t=0; t<FRAMESIZE; t++)
    {
     Serial.print(*text, DEC);
     Serial.print(", ");
     text++;
    }
    Serial.println();
  }
}

void setup() 
{

// writebuff[0]='T';
// writebuff[1]='H';
// writebuff[2]='E';
// writebuff[3]='I';
// writebuff[4]='A';
// writebuff[5]=' ';
// writebuff[6]='S';
// writebuff[7]='P';
// writebuff[8]='A';
// writebuff[9]='C';
// writebuff[10]='E';
// writebuff[11]=0;
  
  Serial.begin();
  delay(1000);
  initTX();
  initRX();

  TXPacketizer.loadPacket(writebuff, FRAMESIZE);
  RXPacketizer.loadPacket(readbuff, FRAMESIZE);
  
  vSpiInitialize();
  TXTransceiver.begin(ESAT_RadioTransceiverClass::TXInterruptsMode);
  TXTransceiver.setChannel(5); //0 TX  
  //TXTransceiver.setFrequency(438.17);
  TXTransceiver.configureModulationType(ESAT_RadioTransceiverClass::twoFSK);
  
  RXTransceiver.begin(ESAT_RadioTransceiverClass::RXInterruptsMode);
  RXTransceiver.setChannel(3); //1 RX
  //RXTransceiver.setFrequency(438.17);
  RXTransceiver.configureModulationType(ESAT_RadioTransceiverClass::twoFSK);
  RXTransceiver.startReception();
  
  interrupts();
  TXTransceiver.write_NonBlocking(TXPacketizer.feedTrimmedPacket());
}

void loop() 
{ 
  if (TXPacketizer.getRemainingPacketSize()) //packet isn't trsnsmitted yet
  {
    if (TXTransceiver.available())
    {
      TXTransceiver.write_NonBlocking(TXPacketizer.feedTrimmedPacket());
    }  
  }
  else
  {
     TXPacketizer.loadPacket(writebuff, FRAMESIZE); //reload packet
  }


  if (RXPacketizer.getRemainingPacketSize()>0)
  {
    //Serial.print("Remaining size: ");
    //Serial.println(RXPacketizer.getRemainingPacketSize(), DEC);
    if(RXTransceiver.available())
    {
      RXPacketizer.mergeTrimmedPacket(RXTransceiver.read_NonBlocking(), 129);
      Serial.println("Reading");
      Serial.print("RSSI: ");
      Serial.println (RXTransceiver.getRSSI(), DEC);
    }
  }
  else
  {
    Serial.println("Printing");
    debug((const char*) RXPacketizer.getPacketPointer());
    initRX(); //clears buffer
    RXPacketizer.loadPacket(readbuff, FRAMESIZE);
    //RXTransceiver.startReception();
  }
  delay(1);     
}
